## drivers/power/supply/maxim/Kconfig
```kconfig
config FUELGAUGE_MAX77729
	tristate
	prompt "Support as maxim fuel gauge IC."
	default n
	help
		It's an fuel gauge driver.

config CHARGER_MAX77729
	tristate
	prompt "Support charger Driver."
	default n
	help
		It's an charger driver.
```
